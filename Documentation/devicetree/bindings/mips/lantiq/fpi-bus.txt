## Documentation/devicetree/bindings/mips/lantiq/fpi-bus.txt
```
Lantiq XWAY SoC FPI BUS binding
============================


-------------------------------------------------------------------------------
Required properties:
- compatible	: Should be one of
				"lantiq,xrx200-fpi"
- reg		: The address and length of the XBAR configuration register.
		  Address and length of the FPI bus itself

Optional properties:
- regmap		: A phandle to the RCU syscon
- offset-endianness	: Offset of the endianness configuration register

-------------------------------------------------------------------------------
Example for the FPI on the xrx200 SoCs:
	fpi@10000000 {
		compatible = "lantiq,xrx200-fpi", "simple-bus";
		ranges = <0x0 0x10000000 0xf000000>;
		reg =	<0x1f400000 0x1000>,
			<0x10000000 0xf000000>;
		regmap = <&rcu0>;
		offset-endianness = <0x4c>;
		#address-cells = <1>;
		#size-cells = <1>;

		gptu@e100a00 {
			......
		};
	};
```

## Documentation/devicetree/bindings/mips/lantiq/rcu-gphy.txt
```
Lantiq XWAY SoC GPHY binding
============================

This binding describes a software-defined ethernet PHY, provided by the RCU
module on newer Lantiq XWAY SoCs (xRX200 and newer).

-------------------------------------------------------------------------------
Required properties (controller (parent) node):
- compatible		: Should be one of
				"lantiq,xrx200a1x-rcu-gphy"
				"lantiq,xrx200a2x-rcu-gphy"
				"lantiq,xrx300-rcu-gphy"
				"lantiq,xrx330-rcu-gphy"
- lantiq,rcu-syscon	: A phandle and offset to the GPHY address registers in
			  the RCU
- resets		: Must reference the RCU GPHY reset bit
- reset-names		: One entry, value must be "gphy" or optional "gphy2"

Optional properties (port (child) node):
- lantiq,gphy-mode	: GPHY_MODE_GE (default) or GPHY_MODE_FE as defined in
			  <dt-bindings/mips/lantiq_xway_gphy.h>
- clocks		: A reference to the (PMU) GPHY clock gate


-------------------------------------------------------------------------------
Example for the GPHys on the xRX200 SoCs:

#include <dt-bindings/mips/lantiq_rcu_gphy.h>
	gphy0: gphy@0 {
		compatible = "lantiq,xrx200a2x-rcu-gphy";
		reg = <0>;

		lantiq,rcu-syscon = <&rcu0 0x20>;
		resets = <&reset0 31 30>, <&reset1 7 7>;
		reset-names = "gphy", "gphy2";
		lantiq,gphy-mode = <GPHY_MODE_GE>;
		clocks = <&pmu0 XRX200_PMU_GATE_GPHY>;
	};
```

## Documentation/devicetree/bindings/mips/lantiq/rcu.txt
```
Lantiq XWAY SoC RCU binding
===========================

This binding describes the RCU (reset controller unit) multifunction device,
where each sub-device has it's own set of registers.

The RCU register range is used for multiple purposes. Mostly one device
uses one or multiple register exclusively, but for some registers some
bits are for one driver and some other bits are for a different driver.
With this patch all accesses to the RCU registers will go through
syscon.


-------------------------------------------------------------------------------
Required properties:
- compatible	: The first and second values must be:
		  "lantiq,xrx200-rcu", "simple-mfd", "syscon"
- reg		: The address and length of the system control registers


-------------------------------------------------------------------------------
Example of the RCU bindings on a xRX200 SoC:
	rcu0: rcu@203000 {
		compatible = "lantiq,xrx200-rcu", "simple-mfd", "syscon";
		reg = <0x203000 0x100>;
		ranges = <0x0 0x203000 0x100>;
		big-endian;

		gphy0: gphy@0 {
			compatible = "lantiq,xrx200a2x-gphy";
			reg = <0x20 0x4>;

			resets = <&reset0 31 30>, <&reset1 7 7>;
			reset-names = "gphy", "gphy2";
			lantiq,gphy-mode = <GPHY_MODE_GE>;
		};

		gphy1: gphy@1 {
			compatible = "lantiq,xrx200a2x-gphy";
			reg = <0x68 0x4>;

			resets = <&reset0 29 28>, <&reset1 6 6>;
			reset-names = "gphy", "gphy2";
			lantiq,gphy-mode = <GPHY_MODE_GE>;
		};

		reset0: reset-controller@0 {
			compatible = "lantiq,xrx200-reset";

			offset-set = <0x10>;
			offset-status = <0x14>;
			#reset-cells = <2>;
		};

		reset1: reset-controller@1 {
			compatible = "lantiq,xrx200-reset";

			offset-set = <0x48>;
			offset-status = <0x24>;
			#reset-cells = <2>;
		};

		usb_phy0: usb2-phy@0 {
			compatible = "lantiq,xrx200-usb2-phy";
			status = "disabled";

			regmap = <&rcu0>;
			offset-phy = <0x18>;
			offset-ana = <0x38>;
			resets = <&reset1 4 4>, <&reset0 4 4>;
			reset-names = "phy", "ctrl";
			#phy-cells = <0>;
		};

		usb_phy1: usb2-phy@1 {
			compatible = "lantiq,xrx200-usb2-phy";
			status = "disabled";

			regmap = <&rcu0>;
			offset-phy = <0x34>;
			offset-ana = <0x3C>;
			resets = <&reset1 5 4>, <&reset0 4 4>;
			reset-names = "phy", "ctrl";
			#phy-cells = <0>;
		};

		reboot {
			compatible = "syscon-reboot";

			regmap = <&rcu0>;
			offset = <0x10>;
			mask = <0x40000000>;
		};
	};
```

## Documentation/devicetree/bindings/mtd/ubi.txt
```
UBI - Unsorted block images

Describe of a UBI layer in device tree.

 - compatible:		"ubi,device", This marks a partition that contains
 			a ubi layer.
 - vid_hdr_offs:	Optional parameter specifies UBI VID header position
 			to be used by UBI. (default value if 0)
 - max_beb_per1024:	Optional parameter specifies the maximum expected bad
 			eraseblock per 1024 eraseblocks.
 			(default value CONFIG_MTD_UBI_BEB_LIMIT)
 -ubi_num:		Optional parameter specifies UBI device number
 			which have to be assigned to the newly created UBI
 			device (assigned automatically by default)

Example:

partitions {
	compatible = "fixed-partitions";
	#address-cells = <1>;
	#size-cells = <1>;

	partition@0 {
		label = "uboot";
		reg = <0x00000 0x100000>;
	};

	partition@1c0000 {
		label = "system_sw";
		reg = <0x1c0000 0xc800000>;
		compatible = "ubi,device";
	};
};
```

## Documentation/devicetree/bindings/net/dsa/lantiq-gswip.txt
```
Lantiq GSWIP Ethernet switches
==================================

Required properties:

- compatible	: "lantiq,xrx200-gswip" for the embedded GSWIP in the 
		  xRX200 SoC

Optional properties:

- lantiq,phys	: A list of phandles of the FW loader of the embedded
		  Ethernet PHYs phys. This is used to make sure the
		  firmware is loaded into the embedded PHY before this
		  driver is loaded and accesses them over the MDIO bus.

See Documentation/devicetree/bindings/net/dsa/dsa.txt for a list of additional
required and optional properties.

Example:

Ethernet switch on the VRX200 SoC:

gswip: gswip@E108000 {
	#address-cells = <1>;
	#size-cells = <0>;
	compatible = "lantiq,xrx200-gswip";
	reg = <	0xE108000 0x3000 /* switch */
		0xE10B100 0x70 /* mdio */
		0xE10B1D8 0x30 /* mii */
		>;
	dsa,member = <0 0>;

	ports {
		#address-cells = <1>;
		#size-cells = <0>;

		port@0 {
			reg = <0>;
			label = "lan3";
			phy-mode = "rgmii";
			phy-handle = <&phy0>;
		};

		port@1 {
			reg = <1>;
			label = "lan4";
			phy-mode = "rgmii";
			phy-handle = <&phy1>;
		};

		port@2 {
			reg = <2>;
			label = "lan2";
			phy-mode = "gmii";
			phy-handle = <&phy11>;
		};

		port@4 {
			reg = <4>;
			label = "lan1";
			phy-mode = "gmii";
			phy-handle = <&phy13>;
		};

		port@5 {
			reg = <5>;
			label = "wan";
			phy-mode = "rgmii";
			phy-handle = <&phy5>;
		};

		port@6 {
			reg = <0x6>;
			label = "cpu";
			ethernet = <&eth0>;
		};
	};

	mdio@0 {
		#address-cells = <1>;
		#size-cells = <0>;
		compatible = "lantiq,xrx200-mdio";
		reg = <0>;

		phy0: ethernet-phy@0 {
			reg = <0x0>;
		};
		phy1: ethernet-phy@1 {
			reg = <0x1>;
		};
		phy5: ethernet-phy@5 {
			reg = <0x5>;
		};
		phy11: ethernet-phy@11 {
			reg = <0x11>;
		};
		phy13: ethernet-phy@13 {
			reg = <0x13>;
		};
	};
};
```

## Documentation/devicetree/bindings/net/lantiq,xrx200-net.txt
```
Lantiq xRX200 PMAC Ethernet driver
==================================

Required properties:

- compatible	: "lantiq,xrx200-net" for the PMAC of the embedded
		: GSWIP in the xXR200
- reg		: memory range of the PMAC core inside of the GSWIP core
- interrupts	: TX and RX DMA interrupts. Use interrupt-names "tx" for 
		: the TX interrupt and "rx" for the RX interrupt.

Optional properties:

- lantiq,phys	: A list of phandles of the FW loader of the embedded
		  Ethernet PHYs phys. This is used to make sure the
		  firmware is loaded into the embedded PHY before this
		  driver is loaded and accesses them over the MDIO bus.

Example:

eth0: eth@E10B308 {
	#address-cells = <1>;
	#size-cells = <0>;
	compatible = "lantiq,xrx200-net";
	reg = <0xE10B308 0x30>;
	interrupts = <73>, <72>;
	interrupt-names = "tx", "rx";
	lantiq,phys = <&gphy0>, <&gphy1>;
};
```

## Documentation/devicetree/bindings/phy/phy-lantiq-rcu-usb2.txt
```
Lantiq XWAY SoC RCU USB 1.1/2.0 PHY binding
===========================================

This binding describes the USB PHY hardware provided by the RCU module on the
Lantiq XWAY SoCs.

This driver has to be a sub node of the Lantiq RCU block.

-------------------------------------------------------------------------------
Required properties (controller (parent) node):
- compatible	: Should be one of
			"lantiq,ase-usb2-phy"
			"lantiq,danube-usb2-phy"
			"lantiq,xrx100-usb2-phy"
			"lantiq,xrx200-usb2-phy"
			"lantiq,xrx300-usb2-phy"
- offset-phy	: Offset of the USB PHY configuration register
- offset-ana	: Offset of the USB Analog configuration register
- clocks	: References to the (PMU) "ctrl" and "phy" clk gates.
- clock-names	: Must be one of the following:
			"ctrl"
			"phy"
- resets	: References to the RCU USB configuration reset bits.
- reset-names	: Must be one of the following:
			"phy" (optional)
			"ctrl" (shared)

-------------------------------------------------------------------------------
Example for the USB PHYs on an xRX200 SoC:
	usb_phy0: usb2-phy@0 {
		compatible = "lantiq,xrx200-usb2-phy";

		offset-phy = <0x18>;
		offset-ana = <0x38>;
		clocks = <&pmu PMU_GATE_USB0_CTRL>,
			 <&pmu PMU_GATE_USB0_PHY>;
		clock-names = "ctrl", "phy";
		resets = <&reset1 4 4>, <&reset0 4 4>;
		reset-names = "phy", "ctrl";
		#phy-cells = <0>;
	};
```

## Documentation/devicetree/bindings/reset/lantiq,rcu-reset.txt
```
Lantiq XWAY SoC RCU reset controller binding
============================================

This binding describes a reset-controller found on the RCU module on Lantiq
XWAY SoCs.


-------------------------------------------------------------------------------
Required properties (controller (parent) node):
- compatible		: Should be "lantiq,rcu-reset"
- lantiq,rcu-syscon	: A phandle to the RCU syscon, the reset register
			  offset and the status register offset.
- #reset-cells		: Specifies the number of cells needed to encode the
			  reset line, should be 1.

Optional properties:
- reset-status		: The request status bit. For some bits the request bit
			  and the status bit are different. This is depending
			  on the SoC. If the reset-status bit does not match
			  the reset-request bit, put the reset number into the
			  reset-request property and the status bit at the same
			  index into the reset-status property. If no
			  reset-request bit is given here, the driver assume
			  status and request bit are the same.
- reset-request		: The reset request bit, to map it to the reset-status
			  bit.


-------------------------------------------------------------------------------
Example for the reset-controllers on the xRX200 SoCs:
	rcu_reset0: rcu_reset {
		compatible = "lantiq,rcu-reset";
		lantiq,rcu-syscon = <&rcu0 0x10 0x14>;
		#reset-cells = <1>;
		reset-request = <31>, <29>, <21>, <19>, <16>, <12>;
		reset-status  = <30>, <28>, <16>, <25>, <5>,  <24>;
	};

	rcu_reset1: rcu_reset {
		compatible = "lantiq,rcu-reset";
		lantiq,rcu-syscon = <&rcu0 0x48 0x24>;
		#reset-cells = <1>;
	};
```

## Documentation/devicetree/bindings/reset/lantiq,reset.txt
```
Lantiq XWAY SoC RCU reset controller binding
============================================

This binding describes a reset-controller found on the RCU module on Lantiq
XWAY SoCs.

This driver has to be a sub node of the Lantiq RCU block. 

-------------------------------------------------------------------------------
Required properties:
- compatible		: Should be one of
				"lantiq,danube-reset"
				"lantiq,xrx200-reset"
- offset-set		: Offset of the reset set register
- offset-status		: Offset of the reset status register
- #reset-cells		: Specifies the number of cells needed to encode the
			  reset line, should be 2.
			  The first cell takes the reset set bit and the
			  second cell takes the status bit.

-------------------------------------------------------------------------------
Example for the reset-controllers on the xRX200 SoCs:
	reset0: reset-controller@0 {
		compatible = "lantiq,xrx200-reset";

		offset-set = <0x10>;
		offset-status = <0x14>;
		#reset-cells = <2>;
	};
```

## Documentation/devicetree/bindings/watchdog/lantiq-wdt.txt
```
Lantiq WTD watchdog binding
============================

This describes the binding of the Lantiq watchdog driver.

-------------------------------------------------------------------------------
Required properties:
- compatible		: Should be one of
				"lantiq,wdt"
				"lantiq,wdt-xrx100"
				"lantiq,wdt-falcon"

Optional properties:
- regmap		: A phandle to the RCU syscon
- offset-status		: Offset of the reset cause register
- mask-status		: Mask of the reset cause register value


-------------------------------------------------------------------------------
Example for the watchdog on the xRX200 SoCs:
		watchdog@803F0 {
			compatible = "lantiq,wdt-xrx200", "lantiq,wdt-xrx100";
			reg = <0x803F0 0x10>;

			regmap = <&rcu0>;
			offset-status = <0x14>;
			mask-status = <0x80000000>;
		};
```

## drivers/phy/lantiq/Kconfig
```kconfig
#
# Phy drivers for Lantiq / Intel platforms
#
config PHY_LANTIQ_RCU_USB2
	tristate "Lantiq XWAY SoC RCU based USB PHY"
	depends on SOC_TYPE_XWAY
	depends on OF
	select GENERIC_PHY
	help
	  Support for the USB PHY(s) on the Lantiq / Intel XWAY family SoCs.
```
